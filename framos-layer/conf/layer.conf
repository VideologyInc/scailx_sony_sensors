## framos-layer/conf/layer.conf
```bitbake
# We have a conf and classes directory, add to BBPATH
BBPATH .= ":${LAYERDIR}"

# We have a packages directory, add to BBFILES
BBFILES += "${LAYERDIR}/recipes-*/*/*.bb \
            ${LAYERDIR}/recipes-*/*/*.bbappend"

BBFILE_COLLECTIONS += "framos-layer"
BBFILE_PATTERN_framos-layer := "^${LAYERDIR}/"
# give it a priority higher than scailx layer
BBFILE_PRIORITY_framos-layer = "14"

LAYERDEPENDS_framos-layer = "videology-bsp videology-distro"
LAYERSERIES_COMPAT_framos-layer = "scarthgap"

CORE_IMAGE_EXTRA_INSTALL:append:imx8mp = " framos-vvcam-module sony-devicetrees sony-devicetrees-dbg isp-imx-sony"
```

## my-layer/conf/layer.conf
```bitbake
# We have a conf and classes directory, add to BBPATH
BBPATH .= ":${LAYERDIR}"

# We have a packages directory, add to BBFILES
BBFILES += "${LAYERDIR}/recipes-*/*/*.bb \
            ${LAYERDIR}/recipes-*/*/*.bbappend"

BBFILE_COLLECTIONS += "my-layer"
BBFILE_PATTERN_my-layer := "^${LAYERDIR}/"
# give it a priority higher than scailx layer
BBFILE_PRIORITY_my-layer = "14"

LAYERDEPENDS_my-layer = "videology-bsp videology-distro"
LAYERSERIES_COMPAT_my-layer = "scarthgap"
```
